AUTOSAR XML (schema 00051)
package /AUTOSAR/Services/Dem
  client server interface DiagnosticMonitor: is-service=true
    7 x operation, all with possible-error=[DiagnosticMonitor/E_NOT_OK, DiagnosticMonitor/E_OK]:
      ClearPrestoredFreezeFrame
      PrestoreFreezeFrame
      ResetEventDebounceStatus
        arg DebounceResetStatus: category=TYPE_REFERENCE, type=Dem_DebounceResetStatusType, direction=IN
      ResetEventStatus
      ResetMonitorStatus
      SetEventDisabled
      SetEventStatus
        arg EventStatus: category=TYPE_REFERENCE, type=Dem_EventStatusType, direction=IN
    error E_NOT_OK: error-code=1
    error E_OK: error-code=0
  client server interface DiagnosticInfo: is-service=true
    8 x operation:
      GetDebouncingOfEvent: possible-error=[DiagnosticInfo/E_NOT_OK, DiagnosticInfo/E_OK]
        arg DebouncingState: category=TYPE_REFERENCE, type=Dem_DebouncingStateType, direction=OUT
      GetDTCOfEvent: possible-error=[DEM_E_NO_DTC_AVAILABLE, DiagnosticInfo/E_NOT_OK, DiagnosticInfo/E_OK]
        arg DTCFormat: category=TYPE_REFERENCE, type=Dem_DTCFormatType, direction=IN
        arg DTCOfEvent: category=VALUE, type=uint32, direction=OUT
      GetEventAvailable: possible-error=[DiagnosticInfo/E_NOT_OK, DiagnosticInfo/E_OK]
        arg AvailableStatus: category=VALUE, type=boolean, direction=OUT
      GetEventExtendedDataRecordEx: possible-error=[DEM_BUFFER_TOO_SMALL, DEM_NO_SUCH_ELEMENT, DiagnosticInfo/E_NOT_OK, DiagnosticInfo/E_OK]
        arg RecordNumber: category=VALUE, type=uint8, direction=IN
        arg DestBuffer: category=TYPE_REFERENCE, type=Dem_MaxDataValueType, direction=OUT
        arg BufSize: category=VALUE, type=uint16, direction=INOUT
      GetEventFreezeFrameDataEx: possible-error=[DEM_BUFFER_TOO_SMALL, DEM_NO_SUCH_ELEMENT, DiagnosticInfo/E_NOT_OK, DiagnosticInfo/E_OK]
        4 x arg:
          RecordNumber: category=VALUE, type=uint8, direction=IN
          DataId: category=VALUE, type=uint16, direction=IN
          DestBuffer: category=TYPE_REFERENCE, type=Dem_MaxDataValueType, direction=OUT
          BufSize: category=VALUE, type=uint16, direction=INOUT
      GetEventUdsStatus: possible-error=[DiagnosticInfo/E_NOT_OK, DiagnosticInfo/E_OK]
        arg UDSStatusByte: category=VALUE, type=uint8, direction=OUT
      GetFaultDetectionCounter: possible-error=[DEM_E_NO_FDC_AVAILABLE, DiagnosticInfo/E_NOT_OK, DiagnosticInfo/E_OK]
        arg FaultDetectionCounter: category=VALUE, type=sint8, direction=OUT
      GetMonitorStatus: possible-error=[DiagnosticInfo/E_NOT_OK, DiagnosticInfo/E_OK]
        arg MonitorStatus: category=TYPE_REFERENCE, type=Dem_MonitorStatusType, direction=OUT
    6 x error:
      DEM_BUFFER_TOO_SMALL: error-code=21
      DEM_E_NO_DTC_AVAILABLE: error-code=10
      DEM_E_NO_FDC_AVAILABLE: error-code=14
      DEM_NO_SUCH_ELEMENT: error-code=48
      E_NOT_OK: error-code=1
      E_OK: error-code=0
package /AUTOSAR/Services/NvM
  client server interface NvMService: is-service=true
    12 x operation, all with possible-error=[NvMService/E_NOT_OK, NvMService/E_OK]:
      EraseNvBlock
      GetDataIndex
        arg DataIndexPtr: category=VALUE, type=uint8, direction=OUT
      GetErrorStatus
        arg RequestResultPtr: category=TYPE_REFERENCE, type=NvM_RequestResultType, direction=OUT
      InvalidateNvBlock
      ReadBlock
        arg NvM_DstPtr: category=DATA_REFERENCE, type=dtRef_VOID, direction=IN
      ReadPRAMBlock
      RestoreBlockDefaults
        arg NvM_DestPtr: category=DATA_REFERENCE, type=dtRef_VOID, direction=IN
      RestorePRAMBlockDefaults
      SetDataIndex
        arg DataIndex: category=VALUE, type=uint8, direction=IN
      SetRamBlockStatus
        arg BlockChanged: category=VALUE, type=boolean, direction=IN
      WriteBlock
        arg SrcPtr: category=DATA_REFERENCE, type=dtRef_const_VOID, direction=IN
      WritePRAMBlock
    error E_NOT_OK: error-code=1
    error E_OK: error-code=0
