AUTOSAR XML (schema 00051)
package /Components/SwcImplementations
  swc implementation Monitor_Impl: programming-language=C, sw-version=1.6.1, used-code-generator=Embedded Coder 24.1 (R2024a) 19-Nov-2023, vendor-id=0, behavior=Monitor_IB
    code-descriptors:
      code Code
        artifact-descriptors:
          short-label=Monitor_c, category=SWSRC
          short-label=Monitor_h, category=SWHDR
          short-label=Monitor_private_h, category=SWHDR
          short-label=Monitor_types_h, category=SWHDR
    resource consumption RsrcCons_Monitor
