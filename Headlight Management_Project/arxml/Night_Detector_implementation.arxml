AUTOSAR XML (schema 00051)
package /Components/SwcImplementations
  swc implementation Night_Detector_Impl: programming-language=C, sw-version=1.4.1, used-code-generator=Embedded Coder 24.1 (R2024a) 19-Nov-2023, vendor-id=0, behavior=Night_Detector_IB
    code-descriptors:
      code Code
        artifact-descriptors:
          short-label=Night_Detector_c, category=SWSRC
          short-label=Night_Detector_h, category=SWHDR
          short-label=Night_Detector_private_h, category=SWHDR
          short-label=Night_Detector_types_h, category=SWHDR
    resource consumption RsrcCons_Night_Detector
