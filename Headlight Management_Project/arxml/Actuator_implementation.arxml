AUTOSAR XML (schema 00051)
package /Components/SwcImplementations
  swc implementation Actuator_Impl: programming-language=C, sw-version=1.4.1, used-code-generator=Embedded Coder 24.1 (R2024a) 19-Nov-2023, vendor-id=0, behavior=Actuator_IB
    code-descriptors:
      code Code
        artifact-descriptors:
          short-label=Actuator_c, category=SWSRC
          short-label=Actuator_h, category=SWHDR
          short-label=Actuator_private_h, category=SWHDR
          short-label=Actuator_types_h, category=SWHDR
    resource consumption RsrcCons_Actuator
