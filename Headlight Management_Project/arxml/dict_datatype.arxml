AUTOSAR XML (schema 00051)
standard types defined: uint16, uint8, dtRef_VOID, boolean, dtRef_const_VOID, uint32, sint8, boolean_CompuMethod
package /DataTypes
  7 x impl type, all with category=TYPE_REFERENCE, implementation-data-type=uint8:
    Dem_DebounceResetStatusType: compu {0=DEM_DEBOUNCE_STATUS_FREEZE, 1=DEM_DEBOUNCE_STATUS_RESET}
    Dem_EventStatusType: compu {0=DEM_EVENT_STATUS_PASSED, 1=DEM_EVENT_STATUS_FAILED, 2=DEM_EVENT_STATUS_PREPASSED, 3=DEM_EVENT_STATUS_PREFAILED, 4=DEM_EVENT_STATUS_FDC_THRESHOLD_REACHED}
    Dem_DebouncingStateType
    Dem_DTCFormatType: compu {0=DEM_DTC_FORMAT_OBD, 1=DEM_DTC_FORMAT_UDS, 2=DEM_DTC_FORMAT_J1939}
    Dem_MaxDataValueType
    Dem_UdsStatusByteType
    Dem_MonitorStatusType
package /DataTypes/SwAddrMethods
  sw addr method var: memory-allocation-keyword-policy=ADDR-METHOD-SHORT-NAME, section-type=VAR
package /DataTypes/Units
  unit NoUnit: factor-si-to-unit=1, offset-si-to-unit=0
package /DataTypes/ApplDataTypes
  4 x app type, all with category=VALUE, sw-calibration-access=READ-WRITE, compu {identical}:
    TurnSignal_t: range phys 0..2  # User command for Turn signals values: 0: No lights 1: Right signals 2: Left signals
    Visibility_t: range phys 0..300  # Visibility_t Data Type: uint16 Description: Visibility_t is a custom data type used to represent visibility measurements in automotive and environmental applications. It quantifies visibility conditions, such as the distance a vehicle can see or the clarity of the environment, based on sensor data. This type helps in interpreting and utilizing visibility information to enhance safety and system performance. Range: 0 to 100 0: Represents minimal or no visibility. 100: Represents the maximum visibility level the sensor can measure. Units: meter
    Humidity_t: range phys 0..100  # Humidity_t Data Type: uint8 Description: Humidity_t is a custom data type used to represent relative humidity (RH) in automotive applications. This type stores humidity values ranging from 0% to 100% RH with a resolution of 1% RH. The value is scaled by a factor of 10, so each unit of Humidity_t represents 1% RH. Range: 0 to 100, where: 0 represents 0% RH (completely dry air). 100 represents 100% RH (fully saturated air). Resolution: Each increment represents 1% RH, providing high precision in humidity measurements.
    Lux_t: range phys 0..64000  # Lux_t Data Type: uint16 Description: Lux_t is a custom data type used to represent light intensity measurements in lux (lx). This type is designed for scenarios where light levels need to be measured and stored with precision, particularly in automotive and environmental sensing applications. Range: 0 to 64,000 lux. 0 lux represents complete darkness. 64,000 lux represents the maximum measurable light intensity for this data type. Resolution: This type can accurately represent light levels with a granularity of 1 lux. For finer resolution, such as 0.1 lux, you may need to scale the values accordingly (e.g., storing values multiplied by 10).
package /DataTypes/DataTypeMappings
  data type mapping set dictDataTypeMappingsSet
    data-type-maps:
      application-data-type=TurnSignal_t, implementation-data-type=uint8
      application-data-type=Visibility_t, implementation-data-type=DataTypes/uint16
      application-data-type=Humidity_t, implementation-data-type=uint8
      application-data-type=Lux_t, implementation-data-type=DataTypes/uint16
package /Predefined_DEV/ImplementationDataTypes
  impl type NvM_RequestResultType: compu {0=NVM_REQ_OK, 1=NVM_REQ_NOT_OK, 2=NVM_REQ_PENDING, 3=NVM_REQ_INTEGRITY_FAILED, 4=NVM_REQ_BLOCK_SKIPPED, 5=NVM_REQ_NV_INVALIDATED, 6=NVM_REQ_CANCELED, 8=NVM_REQ_RESTORED_FROM_DEFAULTS}, implementation-data-type=uint8
