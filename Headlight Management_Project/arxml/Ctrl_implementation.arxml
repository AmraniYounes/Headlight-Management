AUTOSAR XML (schema 00051)
package /Components/SwcImplementations
  swc implementation Ctrl_Impl: programming-language=C, sw-version=1.7.1, used-code-generator=Embedded Coder 24.1 (R2024a) 19-Nov-2023, vendor-id=0, behavior=Ctrl_IB
    code-descriptors:
      code Code
        artifact-descriptors:
          short-label=Ctrl_c, category=SWSRC
          short-label=Ctrl_h, category=SWHDR
          short-label=Ctrl_private_h, category=SWHDR
          short-label=Ctrl_types_h, category=SWHDR
    resource consumption RsrcCons_Ctrl
