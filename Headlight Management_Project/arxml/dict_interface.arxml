AUTOSAR XML (schema 00051)
package /Interfaces
  12 x sender receiver interface:
    Light_Data
      data Value: category=VALUE, sw-addr-method=var, sw-calibration-access=READ-ONLY, type=Lux_t
    Humidity_Data
      data Value: category=VALUE, sw-addr-method=var, sw-calibration-access=READ-ONLY, type=Humidity_t
    TurnSignal_Cmd
      data Value: category=VALUE, sw-addr-method=var, sw-calibration-access=READ-ONLY, type=TurnSignal_t
    Visibility_Distance
      data Value: category=VALUE, sw-addr-method=var, sw-calibration-access=READ-ONLY, type=Visibility_t
    Ignition_State
      data Value: category=VALUE, sw-addr-method=var, sw-calibration-access=READ-ONLY, type=boolean  # Ignition State: 0: OFF 1: ON
    HighBeam_Cmd
      data Value: category=VALUE, sw-addr-method=var, sw-calibration-access=READ-ONLY, type=boolean  # User command for high Beam activation 0: OFF 1: ON
    Sensor_to_Ctrl
      data Value: category=VALUE, sw-addr-method=var, sw-calibration-access=READ-ONLY, type=boolean  # Sensors detection output values: 0: nothing detected 1: night or fog detected
    Ctrl_to_Act
      data Value: category=VALUE, sw-addr-method=var, sw-calibration-access=READ-ONLY, type=boolean  # Lights state On or OFF (LowBeam, HighBeam, DRL, FogLight, ...): 0: Light should be OFF 1: Light should be ON
    Architecture_Out
      data Value: category=VALUE, sw-addr-method=var, sw-calibration-access=READ-ONLY, type=boolean  # Lights state On or OFF (LowBeam, HighBeam, DRL, FogLight, ...): 0: Light should be OFF 1: Light should be ON
    Final_Out
      data Value: category=VALUE, sw-addr-method=var, sw-calibration-access=READ-ONLY, type=boolean
    HighBeam
      data Value: category=VALUE, sw-addr-method=var, sw-calibration-access=READ-ONLY, type=uint8
    Inter_Comp
      data Value: category=VALUE, sw-addr-method=var, sw-calibration-access=READ-ONLY, type=boolean
