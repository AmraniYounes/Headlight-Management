AUTOSAR XML (schema 00051)
package /Components/SwcImplementations
  swc implementation AutomaticFog_Detector_Impl: programming-language=C, sw-version=1.11.1, used-code-generator=Embedded Coder 24.1 (R2024a) 19-Nov-2023, vendor-id=0, behavior=AutomaticFog_Detector_IB
    code-descriptors:
      code Code
        artifact-descriptors:
          short-label=AutomaticFog_Detector_c, category=SWSRC
          short-label=AutomaticFog_Detector_h, category=SWHDR
          short-label=AutomaticFog_Detector_private_h, category=SWHDR
          short-label=AutomaticFog_Detector_types_h, category=SWHDR
    resource consumption RsrcCons_AutomaticFog_Detector
